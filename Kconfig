## Kconfig
```kconfig
rsource "drivers/Kconfig"
rsource "display/Kconfig"
rsource "rgb/Kconfig"
rsource "sync/Kconfig"
```

## boards/bastardkb/dilemma/Kconfig.dilemma_left
```kconfig
#
# Copyright (c) 2024 The ZMK Contributors
# SPDX-License-Identifier: MIT
#

config BOARD_DILEMMA_LEFT
    select SOC_RP2040
    select RP2_FLASH_W25Q080
    select ZMK_BOARD_COMPAT
    imply RETAINED_MEM
    imply RETENTION
    imply RETENTION_BOOT_MODE
```

## boards/bastardkb/dilemma/board.yml
```yaml
boards:
  - name: dilemma_left
    vendor: bastardkb
    socs:
      - name: rp2040
  - name: dilemma_right
    vendor: bastardkb
    socs:
      - name: rp2040
```

## boards/shields/oled_vik/Kconfig.shield
```kconfig
# Copyright (c) 2026 The ZMK Contributors
# SPDX-License-Identifier: MIT

config SHIELD_OLED_VIK
    def_bool $(shields_list_contains,oled_vik)
    select I2C
```

## boards/shields/procyon_vik/Kconfig.shield
```kconfig
# Copyright (c) 2026 The ZMK Contributors
# SPDX-License-Identifier: MIT

config SHIELD_PROCYON_VIK
    def_bool $(shields_list_contains,procyon_vik)
    select I2C
    imply ZMK_POINTING
```

## display/Kconfig
```kconfig
# Copyright (c) 2026 The ZMK Contributors
# SPDX-License-Identifier: MIT

config DILEMMA_OLED_SCREEN
    bool "Animated status screen for the 128x128 VIK OLED"
    depends on ZMK_DISPLAY_STATUS_SCREEN_CUSTOM
    select LV_USE_THEME_MONO if LV_Z_BITS_PER_PIXEL=1
    help
      Provides zmk_display_status_screen() for the custom status screen.
      The left half is the split peripheral and cannot see layer or output
      state, so this screen renders an animation rather than widgets.
```

## dts/bindings/behaviors/dilemma,behavior-state-sync.yaml
```yaml
# Copyright (c) 2026 The ZMK Contributors
# SPDX-License-Identifier: MIT

description: |
  Internal channel for pushing central-side state to the peripheral. Not
  meant to be bound in keymaps; the central invokes it programmatically and
  the split transport forwards it to the peripheral by name.

compatible: "dilemma,behavior-state-sync"

include: two_param.yaml
```

## rgb/Kconfig
```kconfig
# Copyright (c) 2026 The ZMK Contributors
# SPDX-License-Identifier: MIT

config DILEMMA_LAYER_RGB
    bool "Color the underglow by active layer"
    default y
    depends on ZMK_RGB_UNDERGLOW && ZMK_SPLIT_ROLE_CENTRAL
    help
      Sets the underglow to a solid per-layer color on every layer change.
      Central only: the rgb_ug behavior's global locality forwards each
      change to the peripheral, so both halves stay in step.
```

## sync/Kconfig
```kconfig
# Copyright (c) 2026 The ZMK Contributors
# SPDX-License-Identifier: MIT

config DILEMMA_STATE_SYNC
    bool "Sync modifier state from central to peripheral"
    default y
    depends on ZMK_SPLIT
    help
      Forwards the held-modifier byte to the peripheral as invocations of
      the state_sync behavior, for the peripheral's screen to display.
```
