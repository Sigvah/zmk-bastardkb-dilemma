/*
 * Copyright (c) 2026 The ZMK Contributors
 *
 * SPDX-License-Identifier: MIT
 *
 * Procyon trackpad (https://github.com/george-norton/procyon) connected
 * via the VIK FFC connector. CHG is routed to VIK GPIO_AD1 per the
 * Procyon schematic.
 */

#include <input/processors.dtsi>
#include <dt-bindings/zmk/input_transform.h>

&vik_i2c {
    status = "okay";

    trackpad: maxtouch@4a {
        compatible = "microchip,maxtouch";
        reg = <0x4a>;
        chg-gpios = <&vik_conn 3 (GPIO_ACTIVE_LOW | GPIO_PULL_UP)>; // vik AD_1

        /*
         * Dimensions of the 50x42 Procyon (the early prototype variant).
         * For the 42x50 use  sensor-width = <42>; sensor-height = <50>;
         * For the 57x80 use  sensor-width = <57>; sensor-height = <80>;
         */
        sensor-width = <50>;
        sensor-height = <42>;

        /*
         * Sensor tuning, matching the values QMK's procyon.h uses for this
         * board. Without these the driver's generic defaults are far too
         * insensitive and the pad appears dead.
         */
        gain = <10>;
        touch_threshold = <20>;
        touch_hysteresis = <10>;
        internal_touch_threshold = <10>;
        internal_touch_hysteresis = <5>;
        retransmission_compensation_disable;

        /*
         * Mutual capacitance only. The 50x42 board's matrix size prohibits
         * self capacitance measurements, so the default of 3 yields no
         * usable touch reports on this variant.
         */
        allowed_measurement_types = <1>;

        /* Two fingers on the pad scrolls instead of moving the cursor. */
        two-finger-scroll;

        /*
         * Orientation tweaks if the cursor moves the wrong way:
         * swap-xy; invert-x; invert-y;
         */
    };
};

/ {
    trackpad_listener: trackpad_listener {
        compatible = "zmk,input-listener";
        device = <&trackpad>;

        /*
         * Scroll deltas arrive in raw sensor units (~30 per mm), which is far
         * too fast for wheel detents, so divide them down. Lower the divisor
         * to scroll faster. To flip the scroll direction, add
         * <&zip_scroll_transform INPUT_TRANSFORM_Y_INVERT> here.
         */
        input-processors = <&zip_scroll_scaler 1 40>;
    };
};
