/*
 * Copyright (c) 2026 The ZMK Contributors
 *
 * SPDX-License-Identifier: MIT
 *
 * 1.5" 128x128 OLED (SH1107) on the VIK connector's I2C bus.
 *
 * Wiring, using the VIK I2C pins:
 *   module SDA -> VIK SDA (GP2)
 *   module SCL -> VIK SCL (GP3)
 *   module VCC -> 3V3
 *   module GND -> GND
 *
 * Intended for the left half: the right half's VIK connector is taken by
 * the Procyon trackpad.
 *
 * Zephyr has no SH1107 binding, but it does have sinowealth,sh1106, which
 * the ssd1306 driver services through a page-addressed write path. That
 * path emits only "set page start" (0xB0|page) and the split column
 * address commands, both of which the SH1107 accepts, and it never sends
 * the memory-addressing-mode command that the SH1107 would decode
 * differently. Widening it to 16 pages is therefore just a matter of the
 * height and multiplex ratio below.
 */

&vik_i2c {
    status = "okay";

    oled: sh1107@3c {
        compatible = "sinowealth,sh1106";
        reg = <0x3c>;              // 0x3d on some modules, see L-SDA/L-SCL jumpers

        width = <128>;
        height = <128>;

        segment-offset = <0>;      // the SH1106's 132-column panel needs 2, the SH1107 does not
        page-offset = <0>;
        display-offset = <0>;
        multiplex-ratio = <127>;   // 128 rows, versus 63 for a 128x64 panel
        prechargep = <0x22>;

        /*
         * The module is mounted upside down relative to the controller's
         * native scan order, so flip both axes for a 180 degree rotation.
         * If content ever comes out mirrored instead, drop one of these.
         */
        segment-remap;
        com-invdir;
    };
};

/ {
    chosen {
        zephyr,display = &oled;
    };
};
