## boards/arm/dilemma/Kconfig
```kconfig
#
# Copyright (c) 2024 The ZMK Contributors
# SPDX-License-Identifier: MIT
#

config BOARD_DILEMMA_LEFT
    bool

config BOARD_DILEMMA_RIGHT
    bool
```

## boards/arm/dilemma/Kconfig.board
```kconfig
#
# Copyright (c) 2024 The ZMK Contributors
# SPDX-License-Identifier: MIT
#

config BOARD_DILEMMA_RIGHT
    bool "Dilemma right"
    depends on SOC_RP2040
    select ZMK_USB
    select RP2_FLASH_W25Q080

config BOARD_DILEMMA_LEFT
    bool "Dilemma left"
    depends on SOC_RP2040
    select RP2_FLASH_W25Q080
```

## boards/arm/dilemma/Kconfig.defconfig
```kconfig
#
# Copyright (c) 2024 The ZMK Contributors
# SPDX-License-Identifier: MIT
#

if BOARD_DILEMMA_RIGHT

config ZMK_KEYBOARD_NAME
    default "Dilemma"

config ZMK_SPLIT_ROLE_CENTRAL
    default y

endif # BOARD_DILEMMA_RIGHT

if BOARD_DILEMMA_LEFT || BOARD_DILEMMA_RIGHT
    
config BOARD
    default "dilemma"

config ZMK_SPLIT
    default y

config ZMK_SPLIT_SERIAL
	default y

config SERIAL
    default y

if ZMK_RGB_UNDERGLOW

config WS2812_STRIP
    default y

endif # ZMK_RGB_UNDERGLOW

endif # BOARD_DILEMMA_LEFT || BOARD_DILEMMA_RIGHT
```
