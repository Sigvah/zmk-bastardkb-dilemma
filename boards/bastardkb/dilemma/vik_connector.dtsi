/ {
    vik_conn: vik_connector {
        compatible = "sadekbaroudi,vik-connector";
        #gpio-cells = <2>;
        gpio-map-mask = <0xffffffff 0xffffffc0>;
        gpio-map-pass-thru = <0 0x3f>;
        gpio-map
            = <0 0 &gpio0  2>	/* vik SDA  */
            , <1 0 &gpio0  3>	/* vik SCL  */
            , <2 0 &gpio0 10>	/* vik RGB  */
            , <3 0 &gpio0 12>	/* vik AD_1 */
            , <4 0 &gpio0 23>	/* vik MOSI */
            , <5 0 &gpio0 11>	/* vik AD_2 */
            , <6 0 &gpio0 21>	/* vik CS   */
            , <7 0 &gpio0 20>	/* vik MISO */
            , <8 0 &gpio0 22>	/* vik SCLK */
            ;
    };
};

vik_i2c: &i2c1 {};
vik_spi: &spi0 {};
