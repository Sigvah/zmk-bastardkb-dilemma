/*
 * Copyright (c) 2024 ZMK Contributors
 *
 * SPDX-License-Identifier: MIT
 */

/dts-v1/;
#include "dilemma.dtsi"

&pinctrl {
    pio0_uart0_default: pio0_uart0_default {
        rx_pins {
            pinmux = <PIO0_P13>; // TX Bodged to `QP_RST` and criss-crossed for peripheral half.
            input-enable;
            bias-pull-up;
        };
        tx_pins {
            pinmux = <PIO0_P1>;
        };
    };
};
